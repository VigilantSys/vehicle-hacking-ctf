VERSION ""

NS_ :

BS_:

BU_:

BO_ 100 ActualVehicleSpeed_kph: 8 Vector__XXX
 SG_ ActualVehicleSpeed_kph : 0|24@1+ (0.5,0.0) [0|320] "kph" Vector__XXX

BO_ 201 BatteryPack01VoltagePlus_v: 8 Vector__XXX
 SG_ BatteryPack01VoltagePlus_v : 0|24@1+ (0.25,-100.0) [-100|1000] "v" Vector__XXX

BO_ 202 BatteryPack01VoltageMinus_v: 8 Vector__XXX
 SG_ BatteryPack01VoltageMinus_v : 0|24@1+ (0.25,-100.0) [-100|1000] "v" Vector__XXX

BO_ 301 BatteryPack01Cell001temperature_c: 8 Vector__XXX
 SG_ BatteryPack01Cell001temperature_c : 0|24@1+ (0.5,-40) [-40|1000] "degC" Vector__XXX

BO_ 468 VehicleSecurity: 8 Vector__XXX
  SG_ TimeArmed : 0|16@1+ (1,0) [0|65535] "sec" Vector__XXX
  SG_ Locked : 16|24@1+ (1,0) [0|0] "bool" Vector__XXX
  SG_ FobKey : 24|48@1+ (1,0) [0|16777216] "int" Vector__XXX
  SG_ Nonce : 48|64@1+ (1,0) [0|65535] "int" Vector__XXX

BO_ 500 BMSRelay01Status_enum: 8 Vector__XXX
  SG_ BMSRelay01Status : 0|24@1+ (1,0.0) [0|9999999] "status" Vector__XXX

BO_ 501 BMSRelay01StatusQualifier_enum: 8 Vector__XXX
  SG_ BMSRelay01StatusQualifier : 0|24@1+ (1,0.0) [0|5] "qualifier" Vector__XXX

BO_ 600 BatteryPack01ShuntPlusCurrent_a: 8 Vector__XXX
  SG_ BatteryPack01ShuntPlusCurrent_a : 8|16@1+ (0.02,5.0) [0|10000] "amp" Vector__XXX

BO_ 601 BatteryPack01ShuntMinusCurrent_a: 8 Vector__XXX
  SG_ BatteryPack01ShuntMinusCurrent_a : 0|24@1+ (0.01,0.0) [0|10000] "amp" Vector__XXX

BO_ 602 BatteryPack01ShuntPlusCurrentQualifier_enum: 8 Vector__XXX
  SG_ BatteryPack01ShuntPlusCurrentQualifier_enum : 0|24@1+ (1,0.0) [0|5] "qualifier" Vector__XXX

BO_ 603 BatteryPack01ShuntMinusCurrentQualifier_enum: 8 Vector__XXX
  SG_ BatteryPack01ShuntMinusCurrentQualifier_enum : 0|24@1+ (1,0.0) [0|5] "qualifier" Vector__XXX

BA_DEF_ BO_  "GenMsgCycleTime" INT 0 10000;
BA_DEF_DEF_  "GenMsgCycleTime" 50;
